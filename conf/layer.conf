## conf/layer.conf
```bitbake
# We have a conf and classes directory, add to BBPATH
BBPATH .= ":${LAYERDIR}"

# We have recipes-* directories, add to BBFILES
BBFILES += "${LAYERDIR}/recipes-*/*/*.bb \
            ${LAYERDIR}/recipes-*/*/*.bbappend"

BBFILE_COLLECTIONS += "meta-urho3D"
BBFILE_PATTERN_meta-urho3D = "^${LAYERDIR}/"
BBFILE_PRIORITY_meta-urho3D = "6"

LAYERDEPENDS_meta-urho3D = "core"
LAYERSERIES_COMPAT_meta-urho3D = "thud"
```
